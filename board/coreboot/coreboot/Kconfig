## board/coreboot/coreboot/Kconfig
```kconfig
if VENDOR_COREBOOT

config SYS_BOARD
	default "coreboot"

config SYS_VENDOR
	default "coreboot"

config SYS_SOC
	default "coreboot"

config TEXT_BASE
	default 0x01110000

config BOARD_SPECIFIC_OPTIONS # dummy
	def_bool y
	select BOARD_EARLY_INIT_R

config SYS_CAR_ADDR
	hex "Board specific Cache-As-RAM (CAR) address"
	default 0x01920000
	help
	  This option specifies the board specific Cache-As-RAM (CAR) address.

config SYS_CAR_SIZE
	hex "Board specific Cache-As-RAM (CAR) size"
	default 0x4000
	help
	  This option specifies the board specific Cache-As-RAM (CAR) size.

config COREBOOT_CAPSULE_DFU_ALT_INFO
	string "DFU description of the flash region a capsule updates"
	depends on EFI_HAVE_CAPSULE_SUPPORT
	default "sf 0:0=COREBOOT-RECOVERY-A raw 0x40000 0x770000"
	help
	  The dfu_alt_info string for the one image that UEFI capsules
	  update. The default is the RECOVERY_A region of the AMD A/B
	  flash layout (coreboot's board_rave2_ab.fmd).

endif  # CONFIG_VENDOR_COREBOOT
```

## configs/coreboot64-fast_defconfig
```kconfig
CONFIG_X86=y
CONFIG_TEXT_BASE=0x1120000
CONFIG_SYS_MALLOC_LEN=0x2000000
CONFIG_ENV_SOURCE_FILE="coreboot-fast"
CONFIG_NR_DRAM_BANKS=8
CONFIG_ENV_SIZE=0x1000
CONFIG_DEFAULT_DEVICE_TREE="coreboot"
CONFIG_SPL_SYS_MALLOC_F_LEN=0x2000
CONFIG_SPL_TEXT_BASE=0x1110000
CONFIG_SPL_FS_FAT=y
CONFIG_SYS_PCI_64BIT=y
CONFIG_X86_RUN_64BIT=y
CONFIG_VENDOR_COREBOOT=y
CONFIG_TARGET_COREBOOT=y
CONFIG_CC_OPTIMIZE_FOR_SPEED=y
CONFIG_SYS_MONITOR_BASE=0x01120000
CONFIG_FIT=y
CONFIG_FIT_SIGNATURE=y
CONFIG_BOOTSTD_FULL=y
CONFIG_BOOTDELAY=0
CONFIG_USE_BOOTARGS=y
CONFIG_BOOTARGS="root=/dev/sdb3 init=/sbin/init rootwait ro"
CONFIG_SYS_PBSIZE=532
CONFIG_LOGLEVEL=3
CONFIG_SILENT_CONSOLE=y
CONFIG_SYS_CONSOLE_INFO_QUIET=y
CONFIG_SPL_NO_BSS_LIMIT=y
CONFIG_SPL_FS_FAT_DMA_ALIGN=y
CONFIG_SPL_PCI=y
CONFIG_SPL_NVME=y
CONFIG_SPL_NVME_PCI=y
CONFIG_CMD_BOOTMENU=y
CONFIG_CMD_IDE=y
CONFIG_CMD_LSBLK=y
CONFIG_CMD_USB=y
# CONFIG_CMD_SETEXPR is not set
CONFIG_BOOTP_BOOTFILESIZE=y
CONFIG_CMD_EFIDEBUG=y
CONFIG_CMD_TIME=y
CONFIG_CMD_SOUND=y
CONFIG_CMD_EXT4_WRITE=y
CONFIG_MAC_PARTITION=y
# CONFIG_SPL_MAC_PARTITION is not set
# CONFIG_SPL_DOS_PARTITION is not set
# CONFIG_SPL_EFI_PARTITION is not set
CONFIG_ENV_OVERWRITE=y
CONFIG_USE_BOOTFILE=y
CONFIG_BOOTFILE="bzImage"
CONFIG_TFTP_TSIZE=y
CONFIG_USE_ROOTPATH=y
CONFIG_SYSCON=y
# CONFIG_ACPIGEN is not set
# CONFIG_SCSI_AHCI is not set
CONFIG_SYS_IDE_MAXDEVICE=4
CONFIG_SYS_ATA_DATA_OFFSET=0
CONFIG_SYS_ATA_REG_OFFSET=0
CONFIG_SYS_ATA_ALT_OFFSET=0
CONFIG_ATAPI=y
CONFIG_LBA48=y
CONFIG_SYS_64BIT_LBA=y
# CONFIG_MMC is not set
CONFIG_NVME_PCI=y
CONFIG_SPL_PCI_PNP=y
CONFIG_PCI_REGION_MULTI_ENTRY=y
# CONFIG_SCSI is not set
CONFIG_SYS_NS16550_MEM32=y
CONFIG_SOUND=y
CONFIG_SOUND_I8254=y
CONFIG_USB_HUB_DEBOUNCE_TIMEOUT=100
CONFIG_USB_HUB_MIN_POWER_ON_DELAY=20
CONFIG_USB_HUB_SKIP_ROOT_EMPTY_WAIT=y
CONFIG_SYS_USB_EVENT_POLL_VIA_INT_QUEUE=y
CONFIG_VIDEO_DAMAGE=y
CONFIG_CONSOLE_SCROLL_LINES=5
CONFIG_SPL_ACPI=y
# CONFIG_GZIP is not set
CONFIG_SMBIOS_PARSER=y
```

## configs/coreboot64_defconfig
```kconfig
CONFIG_X86=y
CONFIG_TEXT_BASE=0x1120000
CONFIG_SYS_MALLOC_LEN=0x2000000
CONFIG_NR_DRAM_BANKS=8
CONFIG_ENV_SIZE=0x10000
CONFIG_DEFAULT_DEVICE_TREE="coreboot"
CONFIG_SPL_SYS_MALLOC_F_LEN=0x2000
CONFIG_SPL_TEXT_BASE=0x1110000
CONFIG_PRE_CON_BUF_ADDR=0x100000
CONFIG_SPL_FS_FAT=y
CONFIG_SYS_PCI_64BIT=y
CONFIG_X86_RUN_64BIT=y
CONFIG_VENDOR_COREBOOT=y
CONFIG_TARGET_COREBOOT=y
# CONFIG_AHCI is not set
CONFIG_SYS_MONITOR_BASE=0x01120000
CONFIG_FIT=y
CONFIG_FIT_SIGNATURE=y
CONFIG_BOOTSTD_FULL=y
CONFIG_SHOW_BOOT_PROGRESS=y
CONFIG_BOOTDELAY=3
CONFIG_USE_BOOTARGS=y
CONFIG_BOOTARGS="root=/dev/sdb3 init=/sbin/init rootwait ro"
CONFIG_USE_PREBOOT=y
CONFIG_PREBOOT="usb start"
CONFIG_SYS_PBSIZE=532
CONFIG_PRE_CONSOLE_BUFFER=y
CONFIG_SYS_CONSOLE_INFO_QUIET=y
CONFIG_LOG=y
CONFIG_LOGF_LINE=y
CONFIG_LOGF_FUNC=y
CONFIG_DISPLAY_BOARDINFO_LATE=y
CONFIG_SPL_NO_BSS_LIMIT=y
CONFIG_SPL_FS_FAT_DMA_ALIGN=y
CONFIG_SPL_PCI=y
CONFIG_SPL_NVME=y
CONFIG_SPL_NVME_PCI=y
CONFIG_CMD_BOOTMENU=y
CONFIG_CMD_IDE=y
CONFIG_CMD_LSBLK=y
CONFIG_CMD_USB=y
CONFIG_SYS_USB_EVENT_POLL_VIA_INT_QUEUE=y
CONFIG_USB_HUB_MIN_POWER_ON_DELAY=20
CONFIG_USB_HUB_DEBOUNCE_TIMEOUT=100
CONFIG_USB_HUB_SKIP_ROOT_EMPTY_WAIT=y
# CONFIG_CMD_SETEXPR is not set
CONFIG_BOOTP_BOOTFILESIZE=y
CONFIG_CMD_EFIDEBUG=y
CONFIG_CMD_TIME=y
CONFIG_CMD_SOUND=y
CONFIG_CMD_EXT4_WRITE=y
CONFIG_MAC_PARTITION=y
# CONFIG_SPL_MAC_PARTITION is not set
# CONFIG_SPL_DOS_PARTITION is not set
# CONFIG_SPL_EFI_PARTITION is not set
CONFIG_ENV_OVERWRITE=y
CONFIG_ENV_IS_IN_FAT=y
CONFIG_ENV_FAT_INTERFACE="nvme"
CONFIG_ENV_FAT_DEVICE_AND_PART="0:1"
CONFIG_SYS_RELOC_GD_ENV_ADDR=y
CONFIG_USE_BOOTFILE=y
CONFIG_BOOTFILE="bzImage"
CONFIG_TFTP_TSIZE=y
CONFIG_USE_ROOTPATH=y
CONFIG_REGMAP=y
CONFIG_SYSCON=y
# CONFIG_ACPIGEN is not set
# CONFIG_SCSI_AHCI is not set
CONFIG_SYS_IDE_MAXDEVICE=4
CONFIG_SYS_ATA_DATA_OFFSET=0
CONFIG_SYS_ATA_REG_OFFSET=0
CONFIG_SYS_ATA_ALT_OFFSET=0
CONFIG_ATAPI=y
CONFIG_LBA48=y
CONFIG_SYS_64BIT_LBA=y
CONFIG_SPL_FS_LOADER=y
# CONFIG_MMC is not set
CONFIG_NVME_PCI=y
CONFIG_SPL_PCI_PNP=y
CONFIG_PCI_REGION_MULTI_ENTRY=y
# CONFIG_SCSI is not set
CONFIG_SYS_NS16550_MEM32=y
CONFIG_SOUND=y
CONFIG_SOUND_I8254=y
CONFIG_VIDEO_DAMAGE=y
CONFIG_CONSOLE_SCROLL_LINES=5
CONFIG_SPL_ACPI=y
CONFIG_CMD_DHRYSTONE=y
# CONFIG_GZIP is not set
CONFIG_SMBIOS_PARSER=y
```
